## sdkconfig.defaults
```kconfig
# ESP32-S3 N16R8
CONFIG_IDF_TARGET="esp32s3"

# 16 MB Flash
CONFIG_ESPTOOLPY_FLASHSIZE_16MB=y

# 8 MB Octal PSRAM on ESP32-S3-WROOM-1-N16R8
CONFIG_SPIRAM=y
CONFIG_SPIRAM_MODE_OCT=y
CONFIG_SPIRAM_SPEED_80M=y
CONFIG_SPIRAM_USE_MALLOC=y
CONFIG_SPIRAM_MALLOC_ALWAYSINTERNAL=16384
CONFIG_SPIRAM_TRY_ALLOCATE_WIFI_LWIP=y

# Camera
CONFIG_OV7670_SUPPORT=y
CONFIG_CAMERA_PSRAM_DMA=y

# HTTP server / Wi-Fi
CONFIG_HTTPD_MAX_REQ_HDR_LEN=1024
CONFIG_HTTPD_MAX_URI_LEN=512

# Log
CONFIG_LOG_DEFAULT_LEVEL_INFO=y
```
